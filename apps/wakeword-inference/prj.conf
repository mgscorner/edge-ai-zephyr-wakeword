## CMakeLists.txt
```
cmake_minimum_required(VERSION 3.20.0)

list(APPEND ZEPHYR_EXTRA_MODULES
    /root/zephyrproject/modules/edge-impulse-sdk-zephyr
    ${CMAKE_CURRENT_SOURCE_DIR}/wake-word
)

find_package(Zephyr REQUIRED HINTS $ENV{ZEPHYR_BASE})

project(wakeword_inference)

target_sources(app PRIVATE
    src/main.cpp
)
```

## prj.conf
```kconfig
CONFIG_CPP=y
CONFIG_REQUIRES_FULL_LIBCPP=y

CONFIG_EDGE_IMPULSE_SDK=y

CONFIG_MAIN_STACK_SIZE=16384
CONFIG_HEAP_MEM_POOL_SIZE=49152

CONFIG_CBPRINTF_FP_SUPPORT=y
CONFIG_PICOLIBC_IO_FLOAT=y
```

## src/main.cpp
```c
#include <zephyr/kernel.h>
#include <stdio.h>
#include "edge-impulse-sdk/classifier/ei_run_classifier.h"
#include "test_audio_okydoky.h"
 

/*
 * Edge Impulse integration smoke test.
 *
 * Verifies that the generated model and Edge Impulse SDK
 * are available to the Zephyr application.
 */

// Callback function declaration
static int get_signal_data(size_t offset, size_t length, float *out_ptr);

int main(int argc, char **argv) {

    signal_t signal;            // Wrapper for raw input buffer
    ei_impulse_result_t result; // Used to store inference output
    EI_IMPULSE_ERROR res;       // Return code from inference

   int buf_len = sizeof(test_audio_okydoky) / sizeof(test_audio_okydoky[0]);

    // Make sure that the length of the buffer matches expected input length
    if (buf_len != EI_CLASSIFIER_DSP_INPUT_FRAME_SIZE) {
            printf("ERROR: input size is wrong\n");
            printf("Expected %d samples, got %d\n",
                EI_CLASSIFIER_DSP_INPUT_FRAME_SIZE,
                (int)buf_len);
            return 1;
    }
    // Assign callback function to fill buffer used for preprocessing/inference
    signal.total_length = buf_len;
    signal.get_data = &get_signal_data;

    // Perform DSP pre-processing and inference
    res = run_classifier(&signal, &result, false);

    // Print return code and how long it took to perform inference
    printf("run_classifier returned: %d\r\n", res);
    printf("Timing: DSP %d ms, inference %d ms, anomaly %d ms\r\n",
            result.timing.dsp,
            result.timing.classification,
            result.timing.anomaly);

    // Print the prediction results (classification)
    printf("Predictions:\r\n");
    for (uint16_t i = 0; i < EI_CLASSIFIER_LABEL_COUNT; i++) {
        printf("  %s: ", ei_classifier_inferencing_categories[i]);
        printf("%.5f\r\n", (double)result.classification[i].value);
    }
    return 0;
}

// Callback: fill a section of the out_ptr buffer when requested
static int get_signal_data(size_t offset, size_t length, float *out_ptr) {
    for (size_t i = 0; i < length; i++) {
        out_ptr[i] = test_audio_okydoky[offset + i];
    }

    return EIDSP_OK;
}
```

## src/test_audio_okydoky.h
```c
#pragma once
#include <stddef.h>
// Raw audio input is provided as float32.
// Edge Impulse performs preprocessing and feeds the INT8-quantized model internally.
static const float test_audio_okydoky[] = {
    0.00378418f,
    //... Add audio samples here...
    0.09426880f,
    0.09860229f
};
```
